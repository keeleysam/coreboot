## src/mainboard/cwwk/adl/Kconfig
```kconfig
## SPDX-License-Identifier: GPL-2.0-or-later

config BOARD_CWWK_ADL_N_COMMON
	def_bool n
	select BOARD_ROMSIZE_KB_16384
	select CRB_TPM
	select DRIVERS_UART_8250IO
	select FSP_TYPE_IOT
	select HAVE_ACPI_RESUME
	select HAVE_ACPI_TABLES
	select HAVE_INTEL_PTT
	select INTEL_GMA_HAVE_VBT
	select SOC_INTEL_ALDERLAKE_PCH_N

config BOARD_CWWK_CW_ADL_4L_V1
	select BOARD_CWWK_ADL_N_COMMON
	select SUPERIO_ITE_IT8613E

config BOARD_CWWK_CW_ADLNTB_1C2L_V3
	select BOARD_CWWK_ADL_N_COMMON
	select SUPERIO_ITE_IT8613E

config BOARD_CWWK_CW_ADLN_SFP
	select BOARD_CWWK_ADL_N_COMMON
	select SUPERIO_ITE_IT8625E
	select SOC_INTEL_COMMON_BLOCK_HDA_VERB
	select SMBIOS_TYPE41_PROVIDED_BY_DEVTREE
	select MAINBOARD_HAS_TPM2
	select DRIVERS_OPTION_CFR_ENABLED if PAYLOAD_EDK2 && SMMSTORE

if BOARD_CWWK_ADL_N_COMMON

config MAINBOARD_DIR
	default "cwwk/adl"

config VARIANT_DIR
	default "cw-adl-4l-v1.0"      if BOARD_CWWK_CW_ADL_4L_V1
	default "cw-adlntb-1c2l-v3.0" if BOARD_CWWK_CW_ADLNTB_1C2L_V3
	default "cw-adln-sfp"         if BOARD_CWWK_CW_ADLN_SFP

config MAINBOARD_PART_NUMBER
	default "CW-ADL-4L-V1.0"      if BOARD_CWWK_CW_ADL_4L_V1
	default "CW-ADLNTB-1C2L-V3.0" if BOARD_CWWK_CW_ADLNTB_1C2L_V3
	default "CW-ADLN-SFP+"        if BOARD_CWWK_CW_ADLN_SFP

config MAINBOARD_SMBIOS_PRODUCT_NAME
	default "CW-ADL-4L-V1.0"      if BOARD_CWWK_CW_ADL_4L_V1
	default "CW-X86-P5-V3"        if BOARD_CWWK_CW_ADLNTB_1C2L_V3
	default "CW-ADLN-SFP+"        if BOARD_CWWK_CW_ADLN_SFP

config MAINBOARD_VERSION
	default "CW-ADL-4L-V1.0"      if BOARD_CWWK_CW_ADL_4L_V1
	default "CW-ADLNTB-1C2L-V3.0" if BOARD_CWWK_CW_ADLNTB_1C2L_V3
	default "CW-ADLN-SFP+"        if BOARD_CWWK_CW_ADLN_SFP

config DEVICETREE
	default "devicetree_sfp.cb"   if BOARD_CWWK_CW_ADLN_SFP

config FMDFILE
	default "src/mainboard/\$(CONFIG_MAINBOARD_DIR)/board.fmd" if BOARD_CWWK_CW_ADLN_SFP

# The two original variants share one data.vbt; CW-ADLN-SFP+ has its own.
config INTEL_GMA_VBT_FILE
	default "src/mainboard/\$(MAINBOARDDIR)/variants/\$(CONFIG_VARIANT_DIR)/data.vbt" if BOARD_CWWK_CW_ADLN_SFP
	default "src/mainboard/\$(MAINBOARDDIR)/data.vbt"

config NO_POST
	default y

endif
```
